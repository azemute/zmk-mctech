#include <dt-bindings/led/led.h>

&pinctrl {
    pro_micro_i2c: pro_micro_i2c {
            group1 {
                    psels = <NRF_PSEL(TWIM_SDA, 0, 17)>,
                            <NRF_PSEL(TWIM_SCL, 0, 22)>;
            };
    };

    pro_micro_i2c: pro_micro_i2c {
        group1 {
                    psels = <NRF_PSEL(TWIM_SDA, 0, 17)>,
                            <NRF_PSEL(TWIM_SCL, 0, 22)>;
            low-power-enable;
        };
    };

};